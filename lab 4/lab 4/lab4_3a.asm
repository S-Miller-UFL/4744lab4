;*******************************************
;Lab 4, Section 3a
;Name: Steven Miller
;Class #: 11318
;PI Name: Anthony Stross
;Description: Loads data from "sram_data.asm" from program memory into sram, then loads that data onto the output leds
;*******************************************
;***************INCLUDES*************************************
.include "ATxmega128a1udef.inc"
.include "SRAM_DATA.ASM"
;***************END OF INCLUDES******************************

;*********************************EQUATES********************************
.EQU STACKEND = 0x3fff ;top of stack
.EQU STACKBEGIN = 0x2000 ;bottom of stack
.EQU INPUT = 0B00000000
.EQU OUTPUT = 0B11111111
.EQU IO_START_ADDRESS = 0X224000
.EQU SRAM_START_ADDRESS = 0X128000
.EQU SRAM_END_ADDRESS = 0X12FFFF
.EQU SYSCLK = 2000000
.EQU PRESCALAR = 64
.EQU DESIREDPERIOD = .30
.EQU RECIPROCAL = 1/.30
.EQU OFFSET = 0
;*******************************END OF EQUATES*******************************

;*********************************DEFS********************************
;*******************************END OF DEFS*******************************

;***********MEMORY CONFIGURATION*************************

;***********END OF MEMORY CONFIGURATION***************
;***********MAIN PROGRAM*******************************
.CSEG
.ORG 0X0000
	RJMP MAIN
.ORG 0X0200
MAIN:
	;initialize stack pointer
	LDI R16, LOW(STACKBEGIN)
	out CPU_SPL, R16
	LDI R16, HIGH(STACKEND)
	OUT CPU_SPH, R16
	;INITIALIZE EBI AND TIMER
	RCALL EBI_INIT
	RCALL TIMER_INIT
	;LOAD IO ADDRESS INTO X 
	LDI XL, BYTE1(IO_START_ADDRESS)
	LDI XH, BYTE2(IO_START_ADDRESS)
	LDI R16, BYTE3(IO_START_ADDRESS)
	OUT CPU_RAMPX, R16
	;LOAD SRAM ADDRESS INTO Y
	LDI YL, BYTE1(SRAM_START_ADDRESS)
	LDI YH, BYTE2(SRAM_START_ADDRESS)
	LDI R16, BYTE3(SRAM_START_ADDRESS)
	OUT CPU_RAMPY, R16
	;LOAD SRAM DATA ADDRESS INTO Z
	LDI ZL, BYTE1(SRAM_DATA<<1)
	LDI ZH, BYTE2(SRAM_DATA<<1)
	LDI R16, BYTE3(SRAM_DATA<<1)
	OUT CPU_RAMPZ, R16

	STORE_LOOP:
		;LOAD DATA AT Z INTO R16
		ELPM R16, Z+
		;STORE DATA AT R16 INTO Y
		ST Y+, R16
		;CHECK IF Z IS NULL
		ELPM R16, Z
		CPI R16, 0X00
	BRNE STORE_LOOP

	;RESET Y POINTER
	LDI YL, BYTE1(SRAM_START_ADDRESS)
	LDI YH, BYTE2(SRAM_START_ADDRESS)
	LDI R16, BYTE3(SRAM_START_ADDRESS)
	OUT CPU_RAMPY, R16

	LOAD_LOOP:
		;CHECK IF END OF SRAM
		LDS R16, CPU_RAMPY
		CPI R16, 0X13
		BREQ END
		;LOAD DATA FROM Y INTO R16
		LD R16, Y+
		;STORE R16 INTO X 
		ST X, R16
		;START TIMER
		RCALL TIMER

	RJMP LOAD_LOOP
end:
rjmp end
;******************************************
;NAME:EBI_INIT
;PURPOSE: INITIALIZES EBI SYSTEM
;REGISTERS AFFECTED: EBI_CNTRL
;INPUTS AFFECTED:N/A
;OUTPUTS AFFECTED:PORTK,RE, CS0, CS2
;******************************************
EBI_INIT:
	;SAVE RELATIVE REGISTERS
	PUSH R16
	;INIITIALIZE EBI CONTROL SIGNALS
	LDI R16,0B01010011
	STS PORTH_OUTSET, R16
	LDI R16,0B00000100
	STS PORTH_OUTCLR, R16
	;SET EBI CONTROL SIGNALS TO OUTPUT
	LDI R16, 0B01010111
	STS PORTH_DIRSET, R16
	;SET ADDRESS SIGNALS TO OUTPUT
	LDI R16,0XFF
	STS PORTK_DIRSET, R16
	;SET EBI TYPE TO 3 PORT SRAM ALE1
	LDI R16, 0B00000001
	STS EBI_CTRL, R16
	;CONFIGURE CS0
	LDI R16, 0B00011101
	STS EBI_CS0_CTRLA, R16
	LDI R16, BYTE2(SRAM_START_ADDRESS )
	STS EBI_CS0_BASEADDR, R16
	LDI R16, BYTE3(SRAM_START_ADDRESS )
	STS EBI_CS0_BASEADDR+1, R16
	;CONFIGURE CS2
	LDI R16, 0B00000001
	STS EBI_CS2_CTRLA, R16
	LDI R16, BYTE2(IO_START_ADDRESS)
	STS EBI_CS2_BASEADDR,R16
	LDI R16, BYTE3(IO_START_ADDRESS)
	STS EBI_CS2_BASEADDR+1,R16
	;RESTORE REGISTERS
	POP R16
RET
;******************************************
;NAME:TIMER_INIT
;PURPOSE: INITIALIZES TIMER ON PORT C
;REGISTERS AFFECTED: TCC0_CNT, TCC0_PER, TCC0_INTFLAGS
;INPUTS AFFECTED:N/A
;OUTPUTS AFFECTED:N/A
;******************************************
TIMER_INIT:
	PUSH R16
	;INITIALIZE COUNT REGISTER
	LDI R16, 0B00000000
	STS TCC0_CNT, R16
	STS TCC0_CNT+1, R16
	;INITIALIZE PERIOD REGISTER
	LDI r16,low(((sysclk/prescalar)/reciprocal)+offset)
	STS TCC0_PER, r16
	LDI r16,high(((sysclk/prescalar)/reciprocal)+offset)
	STS TCC0_PER+1,r16
	;CLEAR INTERRUPT FLAGS
	LDI R16, 0B00000001
	STS TCC0_INTFLAGS, R16
	POP R16
RET
;******************************************
;NAME:TIMER
;PURPOSE: THE ACTUAL TIMER
;REGISTERS AFFECTED: TCC0_CNT, TCC0_CTRLA
;INPUTS AFFECTED:N/A
;OUTPUTS AFFECTED:N/A
;******************************************
TIMER:
	PUSH R16
	;INITIALIZE CLKSEL
	LDI R16, TC_CLKSEL_DIV64_gc
	STS TCC0_CTRLA, R16
	TIMER_LOOP:
	;check ov flag
	lds r17,TCC0_INTFLAGS
	;branch if we have overflow
	sbrs  r17,TC0_OVFIF_bp
	rjmp TIMER_LOOP
	;CLEAR COUNT
	LDI R16, 0B00000000
	STS TCC0_CNT, R16
	STS TCC0_CNT+1,R16
	;TURN OFF TIMER
	LDI R16, 0B00000000
	STS TCC0_CTRLA, R16
	;CLEAR OVF
	LDI R16, TC0_BYTEM0_bm
	STS TCC0_INTFLAGS, R16
	POP R16
RET